## components/ili9341/Kconfig.projbuild
```kconfig
menu "TFT ILI9341 Configuration"

	config WIDTH
		int "SCREEN WIDTH"
		range 0 999
		default 240
		help
			The width resolution of the screen.

	config HEIGHT
		int "SCREEN HEIGHT"
		range 0 999
		default 320
		help
			The height resolution of the screen.

	config MOSI_GPIO
		int "MOSI GPIO number"
		range 0 46
		default 23 if IDF_TARGET_ESP32
		default 35 if IDF_TARGET_ESP32S2
		default 19 if IDF_TARGET_ESP32C3
		help
			GPIO number (IOxx) to SPI MOSI.
			Some GPIOs are used for other purposes (flash connections, etc.) and cannot be used to MOSI.
			On the ESP32, GPIOs 35-39 are input-only so cannot be used as outputs.
			On the ESP32-S2, GPIO 46 is input-only so cannot be used as outputs.

	config MISO_GPIO
		int "MISO GPIO number"
		range -1 46
		default 19 if IDF_TARGET_ESP32
		default 33 if IDF_TARGET_ESP32S2
		default 3  if IDF_TARGET_ESP32C3
		help
			GPIO number (IOxx) to SPI MISO (-1 si no queres usar comandos READ).
			Si usas el XPT2046 hay que usar el MISO!			

	config SCLK_GPIO
		int "SCLK GPIO number"
		range 0 46
		default 18 if IDF_TARGET_ESP32
		default 36 if IDF_TARGET_ESP32S2
		default 18 if IDF_TARGET_ESP32C3
		help
			GPIO number (IOxx) to SPI SCLK.
			Some GPIOs are used for other purposes (flash connections, etc.) and cannot be used to SCLK.
			On the ESP32, GPIOs 35-39 are input-only so cannot be used as outputs.
			On the ESP32-S2, GPIO 46 is input-only so cannot be used as outputs.

	config TFT_CS_GPIO
		int "CS GPIO number"
		range 0 46
		default 26 if IDF_TARGET_ESP32
		default 34 if IDF_TARGET_ESP32S2
		default 9  if IDF_TARGET_ESP32C3
		help
			GPIO number (IOxx) to TFT CS.
			Some GPIOs are used for other purposes (flash connections, etc.) and cannot be used to CS.
			On the ESP32, GPIOs 35-39 are input-only so cannot be used as outputs.
			On the ESP32-S2, GPIO 46 is input-only so cannot be used as outputs.

	config DC_GPIO
		int "DC GPIO number"
		range 0 46
		default 4 if IDF_TARGET_ESP32
		default 37 if IDF_TARGET_ESP32S2
		default 10 if IDF_TARGET_ESP32C3
		help
			GPIO number (IOxx) to SPI DC.
			Some GPIOs are used for other purposes (flash connections, etc.) and cannot be used to DC.
			On the ESP32, GPIOs 35-39 are input-only so cannot be used as outputs.
			On the ESP32-S2, GPIO 46 is input-only so cannot be used as outputs.

	config RESET_GPIO
		int "RESET GPIO number"
		range -1 46
		default -1 if IDF_TARGET_ESP32
		default 38 if IDF_TARGET_ESP32S2
		default 1  if IDF_TARGET_ESP32C3
		help
			GPIO number (IOxx) to RESET.
			When it is -1, the RESET isn't performed.
			Some GPIOs are used for other purposes (flash connections, etc.) and cannot be used to RESET.
			On the ESP32, GPIOs 35-39 are input-only so cannot be used as outputs.
			On the ESP32-S2, GPIO 46 is input-only so cannot be used as outputs.

	config BL_GPIO
		int "BACKLIGHT GPIO number"
		range -1 46
		default -1 if IDF_TARGET_ESP32
		default 39 if IDF_TARGET_ESP32S2
		default 2  if IDF_TARGET_ESP32C3
		help
			GPIO number (IOxx) to BACKLIGHT.
			When it is -1, BACKLIGHT isn't performed.
			Some GPIOs are used for other purposes (flash connections, etc.) and cannot be used to BACKLIGHT.
			On the ESP32, GPIOs 35-39 are input-only so cannot be used as outputs.
			On the ESP32-S2, GPIO 46 is input-only so cannot be used as outputs.

	config INVERSION
		bool "Enable Display (color) Inversion"
		default false
		help
			Enable Display (color) Inversion.

	config ROTATE_SCREEN
		bool "Gira la pantalla 90 grados, para usarla vertical"
		default false
		help
			Esta es la opcion que vino por defecto, pero yo la cambie para que sea apaisada.

	config RGB_COLOR
		bool "Change BGR filter to RGB filter"
		default false
		help
			Change BGR color filter to RGB color filter.

	config XPT2046
		bool "Enable XPT2046 Touch Contoller"
		default false
		help
			Enable XPT2046 Touch Contoller.

	config XPT_CS_GPIO
		depends on XPT2046
		int "XPT2046 CS GPIO number"
		range 0 46
		default 4 if IDF_TARGET_ESP32
		default 4 if IDF_TARGET_ESP32S2
		default 4 if IDF_TARGET_ESP32C3
		help
			GPIO number (IOxx) to XPT2046 CS.
			Some GPIOs are used for other purposes (flash connections, etc.) and cannot be used to CS.
			On the ESP32, GPIOs 35-39 are input-only so cannot be used as outputs.
			On the ESP32-S2, GPIO 46 is input-only so cannot be used as outputs.

	config XPT_IRQ_GPIO
		depends on XPT2046
		int "XPT2046 IRQ GPIO number"
		range 0 46
		default 5 if IDF_TARGET_ESP32
		default 5 if IDF_TARGET_ESP32S2
		default 5 if IDF_TARGET_ESP32C3
		help
			GPIO number (IOxx) to XPT2046 IRQ.
			Some GPIOs are used for other purposes (flash connections, etc.) and cannot be used to IRQ.
			On the ESP32, GPIO12 is used as a bootstrapping pin to select output voltage of an internal regulator which powers the flash chip (VDD_SDIO),

	config XPT_ACCURACY
		depends on XPT2046
		int "Touch position accuracy"
		range 2 10
		default 5
		help
			Tolerance of touch position.
			If the difference from the previous position is within this range, it is considered valid.
			The higher the value, the less accurate the position, but the less responsive it is.

	config XPT_CHECK
		depends on XPT2046
		bool "Enable XPT2046 Touch Check"
		default false
		help
			Enable XPT2046 Touch Check.

endmenu
```
